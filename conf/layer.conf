## conf/layer.conf
```bitbake
# We have a conf and classes directory, append to BBPATH
BBPATH .= ":${LAYERDIR}"

# We have a recipes directory, add to BBFILES
BBFILES += "${LAYERDIR}/recipes*/*/*.bb ${LAYERDIR}/recipes*/*/*.bbappend ${LAYERDIR}/images/*.bb"
BBFILES += "${LAYERDIR}/contrib/recipes*/*/*.bb ${LAYERDIR}/contrib/recipes*/*/*.bbappend"

BBFILE_COLLECTIONS += "meta-jwtegra"
BBFILE_PATTERN_meta-jwtegra := "^${LAYERDIR}/"
BBFILE_PRIORITY_meta-jwtegra = "1"

CUDA_BINARIES_NATIVE = "cuda-binaries-ubuntu1604-native"

#ROOTFSPART_SIZE = "30064771072"
#IMAGE_ROOTFS_SIZE = "29360128"
#IMAGE_ROOTFS_SIZE_pn-tegra210-minimal-initramfs = "8192"

LAYERSERIES_COMPAT_meta-jwtegra = "zeus"
```
